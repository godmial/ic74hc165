## Kconfig
```kconfig
menuconfig PKG_IC74HC165
    bool "ic74hc165: 74HC165 GPIO/SPI 驱动"
    depends on RT_USING_COMPONENTS_INIT
    select RT_USING_PIN
    help
      使用 GPIO 或 SPI 方式读取 74HC165 的驱动软件包

    if PKG_IC74HC165
        config PKG_IC74HC165_GPIO_MODE
            bool "启用 GPIO 模式"
            default y

        config PKG_IC74HC165_SPI_MODE
            bool "启用 SPI 模式"
            default n

        config PKG_IC74HC165_SAMPLE
            bool "启用示例代码"
            default y
    endif
```
